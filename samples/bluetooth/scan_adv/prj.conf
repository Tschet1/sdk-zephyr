## prj.conf
```kconfig
CONFIG_BT=y
CONFIG_BT_BROADCASTER=y
CONFIG_BT_OBSERVER=y
CONFIG_BT_DEBUG_LOG=y
CONFIG_LOG_PRINTK=y
```

## src/main.c
```c
/* main.c - Application main entry point */

/*
 * Copyright (c) 2015-2016 Intel Corporation
 *
 * SPDX-License-Identifier: Apache-2.0
 */

#include <zephyr/types.h>
#include <stddef.h>
#include <sys/printk.h>
#include <sys/util.h>
#include "nrf.h"
#include <nrfx_ppi.h>
#include "nrfx.h"

#include <bluetooth/bluetooth.h>
#include <bluetooth/hci.h>

static uint8_t mfg_data[] = { 0xff, 0xff, 0x00 };

static const struct bt_data ad[] = {
	BT_DATA(BT_DATA_MANUFACTURER_DATA, mfg_data, 3),
};

static void scan_cb(const bt_addr_le_t *addr, int8_t rssi, uint8_t adv_type,
		    struct net_buf_simple *buf)
{
	mfg_data[2]++;
}

void main(void)
{
	struct bt_le_scan_param scan_param = {
		.type       = BT_HCI_LE_SCAN_PASSIVE,
		.options    = BT_LE_SCAN_OPT_NONE,
		.interval   = 0x0010,
		.window     = 0x0010,
	};
	int err;

	printk("Starting Scanner/Advertiser Demo\n");

	/* Initialize the Bluetooth Subsystem */
	err = bt_enable(NULL);
	if (err) {
		printk("Bluetooth init failed (err %d)\n", err);
		return;
	}

	printk("Bluetooth initialized\n");

	err = bt_le_scan_start(&scan_param, scan_cb);
	if (err) {
		printk("Starting scanning failed (err %d)\n", err);
		return;
	}


	// We want to set up a PPI channel to capture a timer when the radio is ready to transmit.

	// Alloc PPI channel (get a free PPI channel)
	uint8_t ppi_ch;
	err = nrfx_ppi_channel_alloc(&ppi_ch);
	if(err != NRFX_SUCCESS)
	{
		printk("error");
		return;
	}

	// Connect EVENTS_TXREADY to TASKS_CAPTURE
	err = nrfx_ppi_channel_assign(ppi_ch, (uint32_t) &NRF_RADIO->EVENTS_TXREADY, (uint32_t) &NRF_TIMER2->TASKS_CAPTURE[1]);
	if(err != NRFX_SUCCESS)
	{
		printk("error");
		return;
	}

	// Fork to TASKS_STOP
	// You will notice that the measurement continuously changes. To take only a
	// single time measurement, enable a second task for the same event to stop the timer.
	// err = nrfx_ppi_channel_fork_assign(ppi_ch, (uint32_t) &NRF_TIMER2->TASKS_STOP);
	// if (err != NRFX_SUCCESS) {
	// 	printk("Failed to fork ppi channel (err %d)\n", err);
	// 	return;
	// }

	// enable channel
	err = nrfx_ppi_channel_enable(ppi_ch);
	if(err != NRFX_SUCCESS)
	{
		printk("error");
		return;
	}


	// clear and start timer
	NRF_TIMER2->TASKS_START = 1;
	NRF_TIMER2->TASKS_CLEAR = 1;

	do {
		k_sleep(K_MSEC(400));

		/* Start advertising */
		err = bt_le_adv_start(BT_LE_ADV_NCONN, ad, ARRAY_SIZE(ad),
				      NULL, 0);
		if (err) {
			printk("Advertising failed to start (err %d)\n", err);
			return;
		}

		k_sleep(K_MSEC(400));
		printk("Captured the timer at %d ticks\n", NRF_TIMER2->CC[1]);

		err = bt_le_adv_stop();
		if (err) {
			printk("Advertising failed to stop (err %d)\n", err);
			return;
		}
	} while (1);
}
```
